#include "web_server.h"
#include "web_server_config.h"

#include <stdlib.h>
#include <string.h>

#include "command_handler.h"
#include "esp_http_server.h"
#include "esp_log.h"

static const char *TAG = "web_server";
static httpd_handle_t s_server = NULL;

/* Generated by EMBED_TXTFILES "web/index.html". */
extern const unsigned char index_html_start[]
    asm("_binary_index_html_start");

extern const unsigned char index_html_end[]
    asm("_binary_index_html_end");

static void set_common_headers(httpd_req_t *req)
{
    httpd_resp_set_hdr(req, "Cache-Control", "no-store, no-cache, must-revalidate");
    httpd_resp_set_hdr(req, "Pragma", "no-cache");
    httpd_resp_set_hdr(req, "X-Content-Type-Options", "nosniff");
}

static esp_err_t send_json_text(httpd_req_t *req, const char *json)
{
    if (!json) {
        httpd_resp_send_err(req, HTTPD_500_INTERNAL_SERVER_ERROR, "JSON response allocation failed");
        return ESP_FAIL;
    }

    set_common_headers(req);
    httpd_resp_set_type(req, "application/json; charset=utf-8");
    return httpd_resp_sendstr(req, json);
}

static esp_err_t root_get_handler(httpd_req_t *req)
{
    size_t html_len = index_html_end - index_html_start;

    httpd_resp_set_type(req, "text/html");
    httpd_resp_set_hdr(req, "Cache-Control", "no-store");

    return httpd_resp_send(
        req,
        (const char *)index_html_start,
        html_len
    );
}

static esp_err_t favicon_get_handler(httpd_req_t *req)
{
    httpd_resp_set_status(req, "204 No Content");
    return httpd_resp_send(req, NULL, 0);
}

static esp_err_t api_status_get_handler(httpd_req_t *req)
{
    char *response = command_handler_process("{\"cmd\":\"status\"}");
    esp_err_t err = send_json_text(req, response);
    free(response);
    return err;
}

static esp_err_t api_command_post_handler(httpd_req_t *req)
{
    if (req->content_len <= 0) {
        httpd_resp_send_err(req, HTTPD_400_BAD_REQUEST, "Empty JSON body");
        return ESP_FAIL;
    }

    if (req->content_len > TMS_WEB_MAX_JSON_BODY) {
        httpd_resp_send_err(req, HTTPD_400_BAD_REQUEST, "JSON body too large");
        return ESP_FAIL;
    }

    char *body = calloc(1, (size_t)req->content_len + 1U);
    if (!body) {
        httpd_resp_send_err(req, HTTPD_500_INTERNAL_SERVER_ERROR, "Out of memory");
        return ESP_ERR_NO_MEM;
    }

    int total = 0;
    while (total < req->content_len) {
        int received = httpd_req_recv(req, body + total, req->content_len - total);
        if (received == HTTPD_SOCK_ERR_TIMEOUT) {
            continue;
        }
        if (received <= 0) {
            free(body);
            httpd_resp_send_err(req, HTTPD_400_BAD_REQUEST, "Failed to receive request body");
            return ESP_FAIL;
        }
        total += received;
    }
    body[total] = '\0';

    char *response = command_handler_process(body);
    free(body);

    esp_err_t err = send_json_text(req, response);
    free(response);
    return err;
}

esp_err_t web_server_start(void)
{
    if (s_server) {
        return ESP_OK;
    }

    httpd_config_t config = HTTPD_DEFAULT_CONFIG();
    config.server_port = TMS_WEB_SERVER_PORT;
    config.stack_size = TMS_WEB_TASK_STACK_SIZE;
    config.task_priority = TMS_WEB_TASK_PRIORITY;
    config.max_uri_handlers = TMS_WEB_MAX_URI_HANDLERS;
    config.recv_wait_timeout = TMS_WEB_RECV_WAIT_TIMEOUT_S;
    config.send_wait_timeout = TMS_WEB_SEND_WAIT_TIMEOUT_S;
    config.lru_purge_enable = true;

    esp_err_t err = httpd_start(&s_server, &config);
    if (err != ESP_OK) {
        ESP_LOGE(TAG, "HTTP server start failed: %s", esp_err_to_name(err));
        s_server = NULL;
        return err;
    }

    const httpd_uri_t root_uri = {
        .uri = "/",
        .method = HTTP_GET,
        .handler = root_get_handler,
        .user_ctx = NULL,
    };

    const httpd_uri_t favicon_uri = {
        .uri = "/favicon.ico",
        .method = HTTP_GET,
        .handler = favicon_get_handler,
        .user_ctx = NULL,
    };

    const httpd_uri_t status_uri = {
        .uri = "/api/status",
        .method = HTTP_GET,
        .handler = api_status_get_handler,
        .user_ctx = NULL,
    };

    const httpd_uri_t command_uri = {
        .uri = "/api/command",
        .method = HTTP_POST,
        .handler = api_command_post_handler,
        .user_ctx = NULL,
    };

    if ((err = httpd_register_uri_handler(s_server, &root_uri)) != ESP_OK ||
        (err = httpd_register_uri_handler(s_server, &favicon_uri)) != ESP_OK ||
        (err = httpd_register_uri_handler(s_server, &status_uri)) != ESP_OK ||
        (err = httpd_register_uri_handler(s_server, &command_uri)) != ESP_OK) {
        ESP_LOGE(TAG, "URI registration failed: %s", esp_err_to_name(err));
        httpd_stop(s_server);
        s_server = NULL;
        return err;
    }

    ESP_LOGI(TAG, "TMS Web UI started on HTTP port %u", (unsigned)TMS_WEB_SERVER_PORT);
    return ESP_OK;
}

esp_err_t web_server_stop(void)
{
    if (!s_server) {
        return ESP_OK;
    }

    esp_err_t err = httpd_stop(s_server);
    if (err == ESP_OK) {
        s_server = NULL;
    }
    return err;
}
